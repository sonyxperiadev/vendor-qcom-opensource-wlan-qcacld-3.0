## configs/kalama_gki_kiwi_v2_defconfig
```kconfig
CONFIG_CNSS_OUT_OF_TREE=y
CONFIG_CNSS2=y
CONFIG_BUS_AUTO_SUSPEND=y
CONFIG_CNSS2_DEBUG=y
CONFIG_CNSS_GENL=y
CONFIG_WCNSS_MEM_PRE_ALLOC=y
CONFIG_CNSS_UTILS=y
CONFIG_CNSS2_SSR_DRIVER_DUMP=y

include $(WLAN_ROOT)/configs/kiwi_v2_defconfig
```
